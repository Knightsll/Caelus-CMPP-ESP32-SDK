## components/caelus_cmpp_sdk_esp32/Kconfig
```kconfig
menu "Caelus CMPP ESP32 SDK"

    config CMPP_SDK_PROVISIONING_SSID_PREFIX
        string "First-time setup hotspot/BLE name prefix"
        default "Caelus"
        help
            The SDK appends the last three MAC bytes. Keep this short enough
            that the resulting Wi-Fi SSID is at most 32 bytes.

    config CMPP_SDK_DISPLAY_NAME_PREFIX
        string "Default display name prefix"
        default "Caelus Device"

    config CMPP_SDK_HOSTNAME_PREFIX
        string "Default mDNS hostname prefix"
        default "caelus-device"
        help
            Used for the first-time setup suggestion and as a fallback when no
            hostname is stored. Users can edit it during setup.

    config CMPP_SDK_IDENTITY_NAMESPACE
        string "NVS namespace for identity and pairing"
        default "cmpp_identity"
        help
            Must be at most 15 characters. Keep it stable across firmware
            updates so device identity and credentials do not rotate.

    config CMPP_SDK_HTTP_PORT
        int "MCP HTTP port"
        range 1 65535
        default 8080

    config CMPP_SDK_BLE_PROVISIONING
        bool "Enable Bluetooth LE provisioning"
        default y
        select BT_ENABLED
        select ESP_PROTOCOMM_SUPPORT_SECURITY_VERSION_1
        help
            Advertise a secure Espressif protocomm provisioning service while
            pairing is incomplete. The SoftAP portal remains a recovery path.

    config CMPP_SDK_BLE_POP
        string "Bluetooth LE provisioning proof of possession"
        depends on CMPP_SDK_BLE_PROVISIONING
        default "caelus1234"
        help
            Development proof of possession. Production hardware must inject
            a unique per-device value and put it on the enclosure or QR label.

    config CMPP_SDK_MQTT_ENABLE
        bool "Enable optional CMPP over MQTT client"
        default n
        help
            Keep MCP Streamable HTTP and also connect to a broker provisioned
            over BLE. The application must provide a sufficiently large app
            partition; the included test-board dual-stack profile uses 4 MB.

endmenu
```

## main/Kconfig.projbuild
```kconfig
menu "Caelus CMPP Board"

    config CMPP_VOICE_BOARD
        bool "AI_REC_v2 ESP32-S3 voice terminal"
        depends on IDF_TARGET_ESP32S3
        default n
        select HTTPD_WS_SUPPORT
        select HTTPD_WS_PRE_HANDSHAKE_CB_SUPPORT
        select HTTPD_WS_POST_HANDSHAKE_CB_SUPPORT
        help
            Single-board PCM/PTT bring-up. Reuses BLE provisioning and CMPP.
            Verify the schematic voltage issues and actual S3 part before flashing.

    config CMPP_VOICE_HTTP_PORT
        int "Voice WebSocket port"
        depends on CMPP_VOICE_BOARD
        range 1 65535
        default 8081

    config CMPP_VOICE_FOLLOWUP_TIMEOUT_MS
        int "Quiet timeout for conversation after SW2 (ms)"
        depends on CMPP_VOICE_BOARD
        range 5000 120000
        default 15000

    config CMPP_VOICE_AEC
        bool "Enable MIC3 analogue reference and full-duplex AEC"
        depends on CMPP_VOICE_BOARD
        default n

    config CMPP_VOICE_BARGE_MIN_RMS
        int "Minimum cleaned PCM RMS for playback interruption"
        depends on CMPP_VOICE_BOARD
        range 80 8000
        default 1000

    config CMPP_VOICE_INPUT_GAIN
        int "Microphone gain (dB)"
        depends on CMPP_VOICE_BOARD
        range 0 36
        default 24

    config CMPP_VOICE_OUTPUT_VOLUME
        int "Initial playback volume (percent)"
        depends on CMPP_VOICE_BOARD
        range 0 100
        default 35

    config CMPP_BOARD_PROVISIONING_SSID_PREFIX
        string "First-time setup hotspot prefix"
        default "Caelus-Board"
        help
            The captive portal appends the last three MAC bytes. Keep this
            short enough that the resulting Wi-Fi SSID is at most 32 bytes.

    config CMPP_BOARD_HOSTNAME_PREFIX
        string "Default mDNS hostname prefix"
        default "caelus-board"
        help
            Used for the first-time setup suggestion and as a fallback when no
            hostname is stored. Users can edit the hostname in the setup page.

    config CMPP_BOARD_HTTP_PORT
        int "MCP HTTP port"
        range 1 65535
        default 8080

    config CMPP_BOARD_BLE_PROVISIONING
        bool "Enable Bluetooth LE provisioning"
        default y
        select BT_ENABLED
        select ESP_PROTOCOMM_SUPPORT_SECURITY_VERSION_1
        help
            Advertise a secure Espressif protocomm provisioning service while
            pairing is incomplete. The SoftAP portal remains available as a
            recovery path.

    config CMPP_BOARD_BLE_POP
        string "Bluetooth LE provisioning proof of possession"
        depends on CMPP_BOARD_BLE_PROVISIONING
        default "caelus1234"
        help
            Development proof of possession used by Security 1. Production
            hardware must provision a unique per-device value and put it on
            the enclosure or QR label instead of using this default.

    config CMPP_BOARD_MQTT_ENABLE
        bool "Enable optional CMPP over MQTT client"
        default n
        help
            Keep the MCP Streamable HTTP server and also connect to a broker
            provisioned over BLE. This dual-stack image needs a larger app
            partition than the default 2 MB test-board profile provides.

endmenu
```
