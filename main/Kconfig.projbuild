## main/Kconfig.projbuild
```kconfig
menu "Caelus CMPP Test Board"

    config CMPP_BOARD_PROVISIONING_SSID_PREFIX
        string "First-time setup hotspot prefix"
        default "Caelus-Board"
        help
            The captive portal appends the last three MAC bytes. Keep this
            short enough that the resulting Wi-Fi SSID is at most 32 bytes.

    config CMPP_BOARD_HOSTNAME_PREFIX
        string "Default mDNS hostname prefix"
        default "caelus-board"
        help
            Used for the first-time setup suggestion and as a fallback when no
            hostname is stored. Users can edit the hostname in the setup page.

    config CMPP_BOARD_HTTP_PORT
        int "MCP HTTP port"
        range 1 65535
        default 8080

    config CMPP_BOARD_BLE_PROVISIONING
        bool "Enable Bluetooth LE provisioning"
        default y
        select BT_ENABLED
        select ESP_PROTOCOMM_SUPPORT_SECURITY_VERSION_1
        help
            Advertise a secure Espressif protocomm provisioning service while
            pairing is incomplete. The SoftAP portal remains available as a
            recovery path.

    config CMPP_BOARD_BLE_POP
        string "Bluetooth LE provisioning proof of possession"
        depends on CMPP_BOARD_BLE_PROVISIONING
        default "caelus1234"
        help
            Development proof of possession used by Security 1. Production
            hardware must provision a unique per-device value and put it on
            the enclosure or QR label instead of using this default.

    config CMPP_BOARD_MQTT_ENABLE
        bool "Enable optional CMPP over MQTT client"
        default n
        help
            Keep the MCP Streamable HTTP server and also connect to a broker
            provisioned over BLE. This dual-stack image needs a larger app
            partition than the default 2 MB test-board profile provides.

endmenu
```

## sdkconfig.defaults
```kconfig
CONFIG_MCP_HTTP_AUTH_ENABLE=y
CONFIG_MCP_HTTP_AUTH_BEARER_TOKEN=""
# CONFIG_MCP_HTTP_AUTH_JWT_VERIFY_ENABLE is not set
# CONFIG_MCP_HTTP_AUTH_SCOPE_ENABLE is not set
# CONFIG_MCP_HTTP_OAUTH_METADATA_ENABLE is not set
CONFIG_PARTITION_TABLE_SINGLE_APP_LARGE=y
CONFIG_CMPP_BOARD_PROVISIONING_SSID_PREFIX="Caelus-Board"
CONFIG_CMPP_BOARD_HOSTNAME_PREFIX="caelus-board"
CONFIG_CMPP_BOARD_HTTP_PORT=8080
CONFIG_ESP_CONSOLE_USB_SERIAL_JTAG=y
# CONFIG_ESP_CONSOLE_UART_DEFAULT is not set
CONFIG_BT_ENABLED=y
CONFIG_BT_NIMBLE_ENABLED=y
CONFIG_ESP_PROTOCOMM_SUPPORT_SECURITY_VERSION_1=y
CONFIG_CMPP_BOARD_BLE_PROVISIONING=y
CONFIG_CMPP_BOARD_BLE_POP="caelus1234"
```
